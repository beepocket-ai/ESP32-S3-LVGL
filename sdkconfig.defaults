## sdkconfig.defaults
```kconfig
# LVGL 配置（首次编译时 idf.py 会自动合并到 sdkconfig）
CONFIG_LV_COLOR_DEPTH_16=y
CONFIG_LV_FONT_MONTSERRAT_28=y
CONFIG_LV_MEM_SIZE_KILOBYTES=64

# N16R8：16MB Flash + 8MB PSRAM
CONFIG_ESPTOOLPY_FLASHSIZE_16MB=y
CONFIG_ESPTOOLPY_FLASHSIZE="16MB"

# 自定义分区表：app 4MB（8 张轮播大图 + LVGL 超出 1.5MB）
CONFIG_PARTITION_TABLE_CUSTOM=y
CONFIG_PARTITION_TABLE_CUSTOM_FILENAME="partitions.csv"
```
