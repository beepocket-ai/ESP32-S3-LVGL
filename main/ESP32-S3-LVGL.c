/*
 * ESP32-S3 + 1.54" IPS 240x240 (ST7789) 屏幕连接验证 Demo
 *
 * 接线（用户配置）：
 *   GND  -> GND
 *   VCC  -> 3V3
 *   SCL  -> GPIO12 (SPI2 SCK)
 *   SDA  -> GPIO11 (SPI2 MOSI)
 *   RES  -> GPIO8
 *   DC   -> GPIO9
 *   CS   -> GPIO10
 *   BLK  -> GPIO14
 *
 * 上电后默认启动 LVGL「电子塔罗牌」界面（DEMO_ENABLE=0）；
 * 把 DEMO_ENABLE 改成 1 可回到屏幕验证画面，循环播放：
 *   1. 彩色条（8 条，带文字标签）  —— 验证数据线/颜色是否正常
 *   2. 网格 + 边框 + 四角彩块 + 十字线 —— 验证几何/方向是否正确
 *   3. 动画（弹跳方块 + 彩虹滚动条）—— 验证刷新与 SPI 带宽
 *   4. 代码生成的动画效果（雷达扫描 / 粒子星空 / 彩虹波浪）—— 展示"小视频"效果
 */

#include <stdio.h>
#include <assert.h>
#include <math.h>
#include <string.h>

#include "freertos/FreeRTOS.h"
#include "freertos/task.h"
#include "freertos/semphr.h"
#include "driver/gpio.h"
#include "driver/spi_master.h"
#include "esp_lcd_panel_io.h"
#include "esp_lcd_panel_ops.h"
#include "esp_lcd_panel_st7789.h"
#include "esp_timer.h"
#include "esp_log.h"
#include "esp_heap_caps.h"

#include "tarot_ui.h"

static const char *TAG = "lcd_demo";

/* ---------------- 硬件配置（按需修改） ---------------- */
#define LCD_PIN_SCLK   12
#define LCD_PIN_MOSI   11
#define LCD_PIN_RST     8
#define LCD_PIN_DC      9
#define LCD_PIN_CS     10
#define LCD_PIN_BL     14

#define LCD_HOST       SPI2_HOST
#define LCD_PCLK_HZ    (40 * 1000 * 1000)   // 40MHz；花屏/不稳定可降到 20MHz
#define LCD_H_RES      240
#define LCD_V_RES      240

#define LCD_X_GAP      0                    // 图像整体左右偏移时调整
#define LCD_Y_GAP      0                    // 显存 240x320；面板可视区在显存顶部时为 0，在下方时为 80
                                            // （屏幕上/下出现约 1/3（80 行）雪花或整体偏移，就是这里设错了）
#define LCD_INVERT     1                    // IPS 面板一般需要反色；若颜色像负片改成 0
#define LCD_BGR        1                    // 红蓝互换时改 0

/* 1 = 跑屏幕验证 demo；0 = 启动 LVGL 电子塔罗牌界面 */
#define DEMO_ENABLE    0

#if DEMO_ENABLE

/* ---------------- 8x16 ASCII 点阵字体 (32..126，行优先，bit0 = 最左列) ---------------- */
static const uint8_t font8x16[95][16] = {
    { 0x00, 0x00, 0x00, 0x00, 0x00, 0x00, 0x00, 0x00, 0x00, 0x00, 0x00, 0x00, 0x00, 0x00, 0x00, 0x00 }, /*  32 ' ' */
    { 0x00, 0x08, 0x08, 0x08, 0x08, 0x08, 0x08, 0x08, 0x08, 0x08, 0x00, 0x00, 0x18, 0x18, 0x00, 0x00 }, /*  33 '!' */
    { 0x6C, 0x24, 0x12, 0x00, 0x00, 0x00, 0x00, 0x00, 0x00, 0x00, 0x00, 0x00, 0x00, 0x00, 0x00, 0x00 }, /*  34 '"' */
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    { 0x26, 0x19, 0x00, 0x00, 0x00, 0x00, 0x00, 0x00, 0x00, 0x00, 0x00, 0x00, 0x00, 0x00, 0x00, 0x00 }, /* 126 '~' */
};

#endif /* DEMO_ENABLE */

/* ---------------- 全局对象 ---------------- */
static esp_lcd_panel_io_handle_t io_handle = NULL;
static esp_lcd_panel_handle_t panel_handle = NULL;
static SemaphoreHandle_t flush_done = NULL; // 一次整屏刷完的信号量

#if DEMO_ENABLE
static uint16_t *fb = NULL;                 // 240x240 RGB565 帧缓冲

/* ---------------- 颜色 ---------------- */
#define C_BLACK     0x0000
#define C_WHITE     0xFFFF
#define C_RED       0xF800
#define C_GREEN     0x07E0
#define C_BLUE      0x001F
#define C_YELLOW    0xFFE0
#define C_CYAN      0x07FF
#define C_MAGENTA   0xF81F
#define C_GRAY      0x2945
#define C_NAVY      0x0864

/* ---------------- 底层绘图 ---------------- */
static void put_pixel(int x, int y, uint16_t color)
{
    if (x < 0 || y < 0 || x >= LCD_H_RES || y >= LCD_V_RES) {
        return;
    }
    fb[y * LCD_H_RES + x] = color;
}

static void fill_rect(int x, int y, int w, int h, uint16_t color)
{
    int x0 = x < 0 ? 0 : x;
    int y0 = y < 0 ? 0 : y;
    int x1 = x + w;
    int y1 = y + h;
    if (x1 > LCD_H_RES) {
        x1 = LCD_H_RES;
    }
    if (y1 > LCD_V_RES) {
        y1 = LCD_V_RES;
    }
    for (int yy = y0; yy < y1; yy++) {
        uint16_t *row = fb + yy * LCD_H_RES;
        for (int xx = x0; xx < x1; xx++) {
            row[xx] = color;
        }
    }
}

static void draw_hline(int x, int y, int w, uint16_t color)
{
    fill_rect(x, y, w, 1, color);
}

static void draw_vline(int x, int y, int h, uint16_t color)
{
    fill_rect(x, y, 1, h, color);
}

static void draw_frame(int x, int y, int w, int h, int t, uint16_t color)
{
    fill_rect(x, y, w, t, color);
    fill_rect(x, y + h - t, w, t, color);
    fill_rect(x, y, t, h, color);
    fill_rect(x + w - t, y, t, h, color);
}

static void draw_circle(int cx, int cy, int r, uint16_t color)
{
    int x = r;
    int y = 0;
    int err = 1 - r;
    while (x >= y) {
        put_pixel(cx + x, cy + y, color);
        put_pixel(cx + y, cy + x, color);
        put_pixel(cx - y, cy + x, color);
        put_pixel(cx - x, cy + y, color);
        put_pixel(cx - x, cy - y, color);
        put_pixel(cx - y, cy - x, color);
        put_pixel(cx + y, cy - x, color);
        put_pixel(cx + x, cy - y, color);
        y++;
        if (err < 0) {
            err += 2 * y + 1;
        } else {
            x--;
            err += 2 * (y - x) + 1;
        }
    }
}

static void draw_char(int x, int y, char c, int scale, uint16_t color)
{
    if (c < 32 || c > 126) {
        c = '?';
    }
    const uint8_t *glyph = font8x16[c - 32];
    for (int row = 0; row < 16; row++) {
        uint8_t bits = glyph[row];
        for (int col = 0; col < 8; col++) {
            if (bits & (1 << col)) {
                fill_rect(x + col * scale, y + row * scale, scale, scale, color);
            }
        }
    }
}

static int text_width(const char *s, int scale)
{
    int n = (int)strlen(s);
    return n > 0 ? n * 9 * scale - scale : 0;
}

static void draw_text(int x, int y, const char *s, int scale, uint16_t color)
{
    while (*s) {
        draw_char(x, y, *s, scale, color);
        x += 9 * scale;
        s++;
    }
}

static void draw_text_center(int cx, int y, const char *s, int scale, uint16_t color)
{
    draw_text(cx - text_width(s, scale) / 2, y, s, scale, color);
}

#endif /* DEMO_ENABLE */

/* ---------------- LCD 初始化 ---------------- */
static bool lcd_on_color_trans_done(esp_lcd_panel_io_handle_t panel_io, esp_lcd_panel_io_event_data_t *edata, void *user_ctx)
{
    BaseType_t woken = pdFALSE;
    xSemaphoreGiveFromISR(flush_done, &woken);
    return woken == pdTRUE;
}

static esp_err_t lcd_init(void)
{
    // 1. 背光
    gpio_config_t bl_cfg = {
        .mode = GPIO_MODE_OUTPUT,
        .pin_bit_mask = 1ULL << LCD_PIN_BL,
    };
    ESP_ERROR_CHECK(gpio_config(&bl_cfg));
    gpio_set_level(LCD_PIN_BL, 0); // 先关背光，避免上电花屏

    // 2. SPI 总线
    spi_bus_config_t bus_cfg = {
        .sclk_io_num = LCD_PIN_SCLK,
        .mosi_io_num = LCD_PIN_MOSI,
        .miso_io_num = -1,
        .quadwp_io_num = -1,
        .quadhd_io_num = -1,
        .max_transfer_sz = LCD_H_RES * LCD_V_RES * sizeof(uint16_t),
    };
    ESP_ERROR_CHECK(spi_bus_initialize(LCD_HOST, &bus_cfg, SPI_DMA_CH_AUTO));

    // 3. LCD 面板 IO（SPI -> 命令/数据）
    esp_lcd_panel_io_spi_config_t io_cfg = {
        .cs_gpio_num = LCD_PIN_CS,
        .dc_gpio_num = LCD_PIN_DC,
        .spi_mode = 0,
        .pclk_hz = LCD_PCLK_HZ,
        .trans_queue_depth = 10,
        .lcd_cmd_bits = 8,
        .lcd_param_bits = 8,
    };
    ESP_ERROR_CHECK(esp_lcd_new_panel_io_spi((esp_lcd_spi_bus_handle_t)LCD_HOST, &io_cfg, &io_handle));

    flush_done = xSemaphoreCreateBinary();
    assert(flush_done);
    esp_lcd_panel_io_callbacks_t cbs = {
        .on_color_trans_done = lcd_on_color_trans_done,
    };
    ESP_ERROR_CHECK(esp_lcd_panel_io_register_event_callbacks(io_handle, &cbs, NULL));

    // 4. ST7789 面板
    esp_lcd_panel_dev_config_t panel_cfg = {
        .reset_gpio_num = LCD_PIN_RST,
        .rgb_ele_order = LCD_BGR ? LCD_RGB_ELEMENT_ORDER_BGR : LCD_RGB_ELEMENT_ORDER_RGB,
        .bits_per_pixel = 16,
    };
    ESP_ERROR_CHECK(esp_lcd_new_panel_st7789(io_handle, &panel_cfg, &panel_handle));

    ESP_ERROR_CHECK(esp_lcd_panel_reset(panel_handle));
    ESP_ERROR_CHECK(esp_lcd_panel_init(panel_handle));
#if LCD_INVERT
    ESP_ERROR_CHECK(esp_lcd_panel_invert_color(panel_handle, true));
#endif
    ESP_ERROR_CHECK(esp_lcd_panel_set_gap(panel_handle, LCD_X_GAP, LCD_Y_GAP));
    ESP_ERROR_CHECK(esp_lcd_panel_disp_on_off(panel_handle, true));

#if DEMO_ENABLE
    // 5. 帧缓冲（必须放在可 DMA 的内部 RAM）
    fb = heap_caps_malloc(LCD_H_RES * LCD_V_RES * sizeof(uint16_t), MALLOC_CAP_DMA | MALLOC_CAP_INTERNAL);
    if (fb == NULL) {
        ESP_LOGE(TAG, "framebuffer malloc failed");
        return ESP_ERR_NO_MEM;
    }
    memset(fb, 0, LCD_H_RES * LCD_V_RES * sizeof(uint16_t));
#endif

    gpio_set_level(LCD_PIN_BL, 1); // 开背光
    return ESP_OK;
}

#if DEMO_ENABLE
/* 整屏刷新，并等待 SPI 传输完成（避免动画时改帧缓冲造成撕裂） */
static void lcd_flush(void)
{
    ESP_ERROR_CHECK(esp_lcd_panel_draw_bitmap(panel_handle, 0, 0, LCD_H_RES, LCD_V_RES, fb));
    xSemaphoreTake(flush_done, portMAX_DELAY);
}
#endif /* DEMO_ENABLE */

#if DEMO_ENABLE
/* ---------------- 画面 1：彩色条 ---------------- */
static void demo_color_bars(void)
{
    static const struct {
        uint16_t color;
        const char *name;
        uint16_t text_color;
    } bars[8] = {
        { C_RED,     "RED",     C_WHITE },
        { C_GREEN,   "GREEN",   C_BLACK },
        { C_BLUE,    "BLUE",    C_WHITE },
        { C_WHITE,   "WHITE",   C_BLACK },
        { C_BLACK,   "BLACK",   C_WHITE },
        { C_YELLOW,  "YELLOW",  C_BLACK },
        { C_CYAN,    "CYAN",    C_BLACK },
        { C_MAGENTA, "MAGENTA", C_BLACK },
    };

    int bar_h = LCD_V_RES / 8; // 30 像素高
    for (int i = 0; i < 8; i++) {
        fill_rect(0, i * bar_h, LCD_H_RES, bar_h, bars[i].color);
        draw_text(10, i * bar_h + (bar_h - 16) / 2, bars[i].name, 1, bars[i].text_color);
        if (i > 0) {
            draw_hline(0, i * bar_h, LCD_H_RES, C_GRAY); // 分隔线
        }
    }
    lcd_flush();
}

/* ---------------- 画面 2：网格 / 几何 ---------------- */
static void demo_grid(void)
{
    fill_rect(0, 0, LCD_H_RES, LCD_V_RES, C_BLACK);

    // 网格
    for (int i = 30; i < LCD_H_RES; i += 30) {
        draw_vline(i, 0, LCD_V_RES, C_GRAY);
        draw_hline(0, i, LCD_H_RES, C_GRAY);
    }
    // 外框
    draw_frame(0, 0, LCD_H_RES, LCD_V_RES, 2, C_WHITE);
    // 中心十字
    draw_hline(20, 120, 200, C_RED);
    draw_vline(120, 20, 200, C_RED);
    // 圆
    draw_circle(120, 120, 80, C_WHITE);

    // 四角彩块：用于检查方向/镜像（左上红、右上绿、左下蓝、右下黄）
    fill_rect(12, 12, 10, 10, C_RED);
    fill_rect(LCD_H_RES - 22, 12, 10, 10, C_GREEN);
    fill_rect(12, LCD_V_RES - 22, 10, 10, C_BLUE);
    fill_rect(LCD_H_RES - 22, LCD_V_RES - 22, 10, 10, C_YELLOW);

    // 文字
    draw_text_center(120, 4, "GRID TEST", 1, C_WHITE);
    draw_text_center(120, LCD_V_RES - 20, "240X240", 1, C_WHITE);

    lcd_flush();
}

/* ---------------- 画面 3：动画 ---------------- */
static uint16_t rainbow[256];

static void build_rainbow(void)
{
    static const uint16_t anchors[6] = { C_RED, C_YELLOW, C_GREEN, C_CYAN, C_BLUE, C_MAGENTA };
    for (int i = 0; i < 256; i++) {
        int seg = i * 6 / 256;
        int t = (i * 6 - seg * 256) * 255 / 256;
        uint16_t a = anchors[seg];
        uint16_t b = anchors[(seg + 1) % 6];
        int ar = (a >> 11) & 0x1F, ag = (a >> 5) & 0x3F, ab = a & 0x1F;
        int br = (b >> 11) & 0x1F, bg = (b >> 5) & 0x3F, bb = b & 0x1F;
        int r = ar + (br - ar) * t / 255;
        int g = ag + (bg - ag) * t / 255;
        int bl = ab + (bb - ab) * t / 255;
        rainbow[i] = (uint16_t)((r << 11) | (g << 5) | bl);
    }
}

static void demo_animation(int duration_ms)
{
    build_rainbow();

    int box = 32;
    int x = 20, y = 40;
    int vx = 4, vy = 3;
    int offset = 0;
    int64_t t_last = esp_timer_get_time();
    int64_t t_start = t_last;
    int frames = 0;

    while (esp_timer_get_time() - t_start < (int64_t)duration_ms * 1000) {
        // 背景 + 外框 + 标题
        fill_rect(0, 0, LCD_H_RES, LCD_V_RES, C_NAVY);
        draw_frame(0, 0, LCD_H_RES, LCD_V_RES, 2, C_WHITE);
        draw_text_center(120, 8, "ANIMATION", 1, C_WHITE);

        // 彩虹滚动条
        for (int yy = 216; yy < 240; yy++) {
            uint16_t *row = fb + yy * LCD_H_RES;
            for (int xx = 0; xx < LCD_H_RES; xx++) {
                row[xx] = rainbow[(xx + offset) % 256];
            }
        }

        // 弹跳方块（颜色随位置变化）
        x += vx;
        y += vy;
        if (x <= 2 || x + box >= LCD_H_RES - 2) {
            vx = -vx;
            x += vx;
        }
        if (y <= 24 || y + box >= 214) {
            vy = -vy;
            y += vy;
        }
        uint16_t box_color = rainbow[(x * 2 + y * 3 + offset) % 256];
        fill_rect(x, y, box, box, box_color);
        fill_rect(x + 4, y + 4, box - 8, 8, C_WHITE); // 方向标记

        offset += 3;
        if (offset >= LCD_H_RES) {
            offset = 0;
        }

        lcd_flush();

        frames++;
        int64_t now = esp_timer_get_time();
        if (now - t_last >= 1000000) {
            ESP_LOGI(TAG, "animation fps: %d", frames);
            frames = 0;
            t_last = now;
        }
        vTaskDelay(pdMS_TO_TICKS(5));
    }
}

/* ---------------- 画面 4：代码生成的动画效果 ---------------- */
#define SIN_N 256
static int16_t sin_tab[SIN_N];

static void build_sin_table(void)
{
    for (int i = 0; i < SIN_N; i++) {
        sin_tab[i] = (int16_t)(sinf((float)i * 2.0f * 3.14159265f / SIN_N) * 1000.0f);
    }
}

static void draw_line(int x0, int y0, int x1, int y1, uint16_t color)
{
    int dx = x1 > x0 ? x1 - x0 : x0 - x1;
    int sx = x0 < x1 ? 1 : -1;
    int dy = y1 > y0 ? y0 - y1 : y1 - y0;
    int sy = y0 < y1 ? 1 : -1;
    int err = dx + dy;
    while (1) {
        put_pixel(x0, y0, color);
        if (x0 == x1 && y0 == y1) {
            break;
        }
        int e2 = 2 * err;
        if (e2 >= dy) {
            err += dy;
            x0 += sx;
        }
        if (e2 <= dx) {
            err += dx;
            y0 += sy;
        }
    }
}

/* 效果 A：雷达扫描 */
static void effect_radar(int frame)
{
    const int cx = 120, cy = 120;
    const uint16_t grid_color = 0x0180; // 暗绿

    fill_rect(0, 0, LCD_H_RES, LCD_V_RES, C_BLACK);
    draw_circle(cx, cy, 30, grid_color);
    draw_circle(cx, cy, 60, grid_color);
    draw_circle(cx, cy, 90, grid_color);
    draw_circle(cx, cy, 118, grid_color);
    draw_hline(cx - 118, cy, 236, grid_color);
    draw_vline(cx, cy - 118, 236, grid_color);

    // 扫描线 + 拖尾
    int start = frame * 4;
    for (int k = 0; k < 20; k++) {
        int angle = start - k * 4;
        int idx = (angle * SIN_N / 360) & (SIN_N - 1);
        int cosv = sin_tab[(idx + 64) & (SIN_N - 1)];
        int sinv = sin_tab[idx];
        int x1 = cx + cosv * 118 / 1000;
        int y1 = cy + sinv * 118 / 1000;
        int g = 63 * (20 - k) / 20;
        draw_line(cx, cy, x1, y1, (uint16_t)((g << 5) | (g >> 1)));
    }

    fill_rect(56, 4, 128, 20, C_BLACK);
    draw_text_center(120, 6, "RADAR", 1, C_WHITE);
}

/* 效果 B：粒子星空 */
#define STAR_COUNT 90
static struct {
    int16_t x, y;
    int8_t vx, vy;
    uint16_t color;
} stars[STAR_COUNT];
static uint32_t rng_state = 0x12345678u;

static uint32_t rng_next(void)
{
    rng_state = rng_state * 1664525u + 1013904223u;
    return rng_state;
}

static void init_particles(void)
{
    static const uint16_t palette[6] = { C_WHITE, C_CYAN, C_MAGENTA, C_YELLOW, C_BLUE, C_GREEN };
    for (int i = 0; i < STAR_COUNT; i++) {
        stars[i].x = rng_next() % LCD_H_RES;
        stars[i].y = rng_next() % LCD_V_RES;
        stars[i].vx = (int8_t)((rng_next() % 5) - 2); // -2..2
        stars[i].vy = (int8_t)((rng_next() % 5) - 2);
        stars[i].color = palette[rng_next() % 6];
    }
}

static void effect_particles(int frame)
{
    (void)frame;
    fill_rect(0, 0, LCD_H_RES, LCD_V_RES, C_BLACK);
    for (int i = 0; i < STAR_COUNT; i++) {
        int x = stars[i].x + stars[i].vx;
        int y = stars[i].y + stars[i].vy;
        if (x < 0) {
            x += LCD_H_RES;
        } else if (x >= LCD_H_RES) {
            x -= LCD_H_RES;
        }
        if (y < 0) {
            y += LCD_V_RES;
        } else if (y >= LCD_V_RES) {
            y -= LCD_V_RES;
        }
        stars[i].x = x;
        stars[i].y = y;
        fill_rect(x, y, 2, 2, stars[i].color);
    }

    fill_rect(48, 4, 144, 20, C_BLACK);
    draw_text_center(120, 6, "PARTICLES", 1, C_WHITE);
}

/* 效果 C：彩虹波浪（整行 memcpy，几乎不耗 CPU） */
static void effect_waves(int frame)
{
    for (int y = 0; y < LCD_V_RES; y++) {
        int off = (sin_tab[(y * 3 + frame * 5) & (SIN_N - 1)] * 60) / 1000 + 120;
        off &= 255;
        uint16_t *row = fb + y * LCD_H_RES;
        int first = 256 - off;
        if (first > LCD_H_RES) {
            first = LCD_H_RES;
        }
        memcpy(row, rainbow + off, first * sizeof(uint16_t));
        if (first < LCD_H_RES) {
            memcpy(row + first, rainbow, (LCD_H_RES - first) * sizeof(uint16_t));
        }
    }

    fill_rect(56, 4, 128, 20, C_BLACK);
    draw_text_center(120, 6, "WAVES", 1, C_WHITE);
}

static void demo_effects(int duration_ms)
{
    build_rainbow();
    build_sin_table();
    init_particles();

    int64_t t0 = esp_timer_get_time();
    int64_t t_last = t0;
    int frame = 0;
    int frames = 0;

    while (esp_timer_get_time() - t0 < (int64_t)duration_ms * 1000) {
        int stage = (int)((esp_timer_get_time() - t0) / 3000000) % 3;
        if (stage == 0) {
            effect_radar(frame);
        } else if (stage == 1) {
            effect_particles(frame);
        } else {
            effect_waves(frame);
        }

        lcd_flush();
        frame++;
        frames++;

        int64_t now = esp_timer_get_time();
        if (now - t_last >= 1000000) {
            ESP_LOGI(TAG, "effects fps: %d", frames);
            frames = 0;
            t_last = now;
        }
        vTaskDelay(pdMS_TO_TICKS(5));
    }
}
#endif /* DEMO_ENABLE */

/* ---------------- 入口 ---------------- */
void app_main(void)
{
    ESP_LOGI(TAG, "ESP32-S3 + ST7789 240x240 demo");
    ESP_LOGI(TAG, "SCLK=%d MOSI=%d CS=%d DC=%d RST=%d BL=%d, SPI=%dMHz",
             LCD_PIN_SCLK, LCD_PIN_MOSI, LCD_PIN_CS, LCD_PIN_DC, LCD_PIN_RST, LCD_PIN_BL,
             LCD_PCLK_HZ / 1000000);

    if (lcd_init() != ESP_OK) {
        ESP_LOGE(TAG, "lcd init failed");
        return;
    }
    ESP_LOGI(TAG, "lcd init ok");

#if DEMO_ENABLE
    ESP_LOGI(TAG, "start demo loop");
    while (1) {
        ESP_LOGI(TAG, "demo 1: color bars");
        demo_color_bars();
        vTaskDelay(pdMS_TO_TICKS(4000));

        ESP_LOGI(TAG, "demo 2: grid / geometry");
        demo_grid();
        vTaskDelay(pdMS_TO_TICKS(4000));

        ESP_LOGI(TAG, "demo 3: animation");
        demo_animation(6000);

        ESP_LOGI(TAG, "demo 4: effects (radar / particles / waves)");
        demo_effects(12000);
    }
#else
    // 电子塔罗牌界面（界面逻辑在 tarot_ui.c）
    tarot_ui_start(io_handle, panel_handle);
#endif
}
